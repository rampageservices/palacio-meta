## conf/distro/palacio-none.conf
```bitbake
require conf/distro/include/rk-base.inc

DISTRO = "palacio-none"
DISTRO_NAME = "Palacio"

# Customize distro features
DISTRO_FEATURES = "alsa bluez5 ext2 ipv4 ipv6 ldconfig largefile opengl systemd usbgadget usbhost wifi"

# libc-related
DISTRO_FEATURES += "${DISTRO_FEATURES_LIBC_DEFAULT}"

DISTRO_FEATURES_BACKFILL_CONSIDERED += "pulseaudio sysvinit gobject-introspection-data"
VIRTUAL-RUNTIME_init_manager = "systemd"
VIRTUAL-RUNTIME_initscripts = "systemd-compat-units"
```

## conf/distro/palacio-wayland.conf
```bitbake
require conf/distro/include/rk-base.inc

DISTRO = "palacio-wayland"
DISTRO_NAME = "Palacio"

# Customize distro features
DISTRO_FEATURES = "alsa bluez5 ext2 ipv4 ipv6 ldconfig largefile opengl systemd usbgadget usbhost wayland wifi"

# libc-related
DISTRO_FEATURES += " \
libc-backtrace libc-big-macros libc-bsd libc-cxx-tests libc-catgets libc-charsets libc-crypt libc-crypt-ufc libc-db-aliases libc-envz libc-fcvt libc-fmtmsg libc-fstab libc-ftraverse libc-getlogin libc-idn libc-inet-anl libc-libm libc-locales libc-locale-code libc-memusage libc-nis libc-nsswitch libc-rcmd libc-rtld-debug libc-spawn libc-streams libc-sunrpc libc-utmp libc-utmpx libc-wordexp libc-posix-clang-wchar libc-posix-regexp libc-posix-regexp-glibc libc-posix-wchar-io \
"

DISTRO_FEATURES_BACKFILL_CONSIDERED += "pulseaudio sysvinit"
VIRTUAL-RUNTIME_init_manager = "systemd"
VIRTUAL-RUNTIME_initscripts = "systemd-compat-units"
```

## conf/machine/palacio-rk3288.conf
```bitbake
# Copyright (C) 2017 XXX
# Released under the MIT license (see COPYING.MIT for the terms)

#@TYPE: Machine
#@NAME: Palacio RK3288
#@DESCRIPTION: Palacio board based on Rockchip RK3288 Processor.

include conf/machine/include/rk3288.inc

UBOOT_MACHINE = "tinker-rk3288_defconfig"

#KBUILD_DEFCONFIG = "defconfig"
KERNEL_DEVICETREE = "rk3288-tinker.dtb"

GPTIMG_APPEND_rk3288_forcevariable = "console=ttyS1,115200n8 rw \
	root=PARTUUID=69dad710-2c rootfstype=ext4 init=/sbin/init quiet"

PREFERRED_PROVIDER_virtual/kernel_forcevariable = "linux-palacio-mainline"
MACHINE_ESSENTIAL_EXTRA_RECOMMENDS += "kernel-module-r8723bs kernel-module-mali_kbase"
KERNEL_MODULE_AUTOLOAD +="r8723bs mali_kbase"
```
